## Firmware/build/Firmware/Kconfig/boards/Kconfig
```kconfig
# Load Zephyr board Kconfig descriptions.
osource "C:/ncs/v3.4.0/zephyr/boards/nordic/nrf54lm20dk/Kconfig"
```

## Firmware/build/Kconfig/boards/Kconfig.defconfig.tmp
```kconfig
# Load Zephyr board defconfig descriptions.
osource "C:/ncs/v3.4.0/zephyr/boards/nordic/nrf54lm20dk/Kconfig.defconfig"
```
